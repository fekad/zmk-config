## boards/shields/the_keyboard/Kconfig.shield
```kconfig
config SHIELD_THE_KEYBOARD_LEFT
	def_bool $(shields_list_contains,the_keyboard_left)

config SHIELD_THE_KEYBOARD_RIGHT
	def_bool $(shields_list_contains,the_keyboard_right)
```

## config/boards/shields/the_keyboard/Kconfig.defconfig
```kconfig
if SHIELD_THE_KEYBOARD_LEFT

config ZMK_KEYBOARD_NAME
	default "keyboard-white"

config ZMK_SPLIT_ROLE_CENTRAL
	default y

endif

if SHIELD_THE_KEYBOARD_LEFT || SHIELD_THE_KEYBOARD_RIGHT

config ZMK_SPLIT
	default y

endif
```

## config/boards/shields/the_keyboard/Kconfig.shield
```kconfig
# Copyright (c) 2021 The ZMK Contributors
# SPDX-License-Identifier: MIT

config SHIELD_THE_KEYBOARD_LEFT
	def_bool $(shields_list_contains,the_keyboard_left)

config SHIELD_THE_KEYBOARD_RIGHT
	def_bool $(shields_list_contains,the_keyboard_right)
```
